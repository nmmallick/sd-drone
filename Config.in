## Config.in
```kconfig
source "$BR2_EXTERNAL_SD_DRONE/external/package/mavsdk/Config.in"
source "$BR2_EXTERNAL_SD_DRONE/modules/package/offboard/Config.in"
```

## external/package/mavsdk/Config.in
```kconfig
config BR2_PACKAGE_OFFBOARD
        bool "offboard"
	default y
	select BR2_PACKAGE_MAVSDK
	help
	  Userspace interface to send offboard commands to a
	  Pixhawk 6x using the PX4 autopilot

comment "sd-drone offboard needs a toolchain w/ C++ support"
    depends on !BR2_INSTALL_LIBSTDCPP
```
